`timescale 1ns/1ps

/***************************************************************************************
 * ZX50 DUAL MEMORY CARD SYSTEM TESTBENCH (NoDMA Variant)
 * =====================================================================================
 * Description:
 * [REVISION: "No-DMA" Fallback Variant. Proves that two NoDMA memory cards can 
 * flawlessly coexist on the Z80 backplane, dynamically handing off data bus ownership 
 * based on MMU mappings. All Shadow Bus signals and DMA routing have been removed.]
 * * This testbench physically simulates a full 1MB distributed memory architecture across 
 * a shared Z80 backplane. It instantiates two identical `zx50_mem_card_nodma` digital 
 * twins (Card 0 and Card 1) and drives them using the cycle-accurate Z80 BFM.
 ***************************************************************************************/

module zx50_dual_mem_card_nodma_tb;

    // --- 1. System Clocks (Generated by Timebase) ---
    wire mclk, zclk;
    zx50_clock clk_gen (
        .mclk(mclk),
        .zclk(zclk)
    );

    // --- 2. System Signals ---
    reg reset_n;

    // --- 3. Z80 Backplane Buses ---
    wire [15:0] z80_addr;
    wire [7:0]  z80_data;
    wire z80_mreq_n, z80_iorq_n, z80_wr_n, z80_rd_n, z80_m1_n;
    
    // Wait logic: Wired-AND (if either card pulls low, the bus goes low)
    wire c0_wait_n, c1_wait_n;
    wire shared_wait_n = c0_wait_n & c1_wait_n; 
    
    // Interrupt Daisy Chain
    wire c0_ieo, c1_ieo;
    wire z80_int_n; // Shared open-drain interrupt line

    // [REVISION: 4. Shadow Bus (Inactive for this test) removed entirely]

    // --- 5. BFM Instantiations ---

    // The Z80 Bus Master
    z80_cpu_util z80 (
        .clk(zclk), .addr(z80_addr), .data(z80_data),
        .mreq_n(z80_mreq_n), .iorq_n(z80_iorq_n), 
        .rd_n(z80_rd_n), .wr_n(z80_wr_n), .m1_n(z80_m1_n),
        .wait_n(shared_wait_n)
    );

    // [REVISION: Card 0 updated to NoDMA variant. Shadow ports removed.]
    zx50_mem_card_nodma card0 (
        .mclk(mclk), .reset_n(reset_n), .card_id_sw(4'h0),
        .z80_addr(z80_addr), .z80_data(z80_data),
        .z80_mreq_n(z80_mreq_n), .z80_iorq_n(z80_iorq_n), .z80_wr_n(z80_wr_n), .z80_rd_n(z80_rd_n),
        .z80_m1_n(z80_m1_n), .z80_iei(1'b1), // Top of the chain
        .z80_wait_n(c0_wait_n), .z80_ieo(c0_ieo), .z80_int_n(z80_int_n)
    );

    // [REVISION: Card 1 updated to NoDMA variant. Shadow ports removed.]
    zx50_mem_card_nodma card1 (
        .mclk(mclk), .reset_n(reset_n), .card_id_sw(4'h1),
        .z80_addr(z80_addr), .z80_data(z80_data),
        .z80_mreq_n(z80_mreq_n), .z80_iorq_n(z80_iorq_n), .z80_wr_n(z80_wr_n), .z80_rd_n(z80_rd_n),
        .z80_m1_n(z80_m1_n), .z80_iei(c0_ieo), // Chained from Card 0
        .z80_wait_n(c1_wait_n), .z80_ieo(c1_ieo), .z80_int_n(z80_int_n)
    );

    // --- 6. Test Sequence Variables ---
    integer i, b, seq_num;
    reg [7:0] card_target, phys_page, read_lo, read_hi;
    reg [15:0] bank_addr;
    integer errors = 0;

    initial begin
        // [REVISION: Updated dumpfile name]
        $dumpfile("waves/zx50_dual_mem_card_nodma.vcd");
        $dumpvars(0, zx50_dual_mem_card_nodma_tb);

        // --- Boot Sequence ---
        $display("[%0t] System Power On. Resetting dual cards...", $time);
        reset_n = 1;      
        clk_gen.wait_mclk(5); 
        reset_n = 0;  
        clk_gen.wait_mclk(50); 
        reset_n = 1;

        // Wait for both cards to execute their parallel 16-cycle MMU Hardware Wipe
        clk_gen.wait_mclk(20);
        z80.wait_cycles(5);

        // ==========================================
        // PHASE 1: Write Phase (512 Pages)
        // ==========================================
        $display("[%0t] --- Starting 1MB Interleaved Write Sequence ---", $time);
        
        // 32 loops * 16 banks = 512 total 4K pages
        for (i = 0; i < 32; i = i + 1) begin
            
            // 1. Program the MMU for the current 16 pages
            for (b = 0; b < 16; b = b + 1) begin
             
                // Even banks -> Card 0, Odd banks -> Card 1
                card_target = (b % 2 == 0) ? 8'h00 : 8'h01; 
                phys_page   = (i * 8) + (b / 2); // Physical pages 0 to 255 on each card
                
                // I/O Address: [15:8] = Z80 Bank, [7:0] = 0x30 | Card ID
                z80.io_write( (b << 8) | (8'h30 | card_target), phys_page );
            end
            
            // 2. Write the 16-bit sequence number to the base of each mapped bank
            for (b = 0; b < 16; b = b + 1) begin
                seq_num = (i * 16) + b + 1; // 1 to 512
                bank_addr = b * 16'h1000;
                
                // Write Little Endian
                z80.mem_write(bank_addr,     seq_num & 8'hFF);
                z80.mem_write(bank_addr + 1, (seq_num >> 8) & 8'hFF);
            end
            
            if (i % 8 == 7) $display("[%0t]   Wrote %0d / 512 pages...", $time, (i+1)*16);
        end

        // ==========================================
        // PHASE 2: Read & Verify Phase
        // ==========================================
        $display("[%0t] --- Starting 1MB Interleaved Read/Verify Sequence ---", $time);
        
        // Intentionally clear memory translation maps first by shifting them
        // to ensure we aren't just reading leftover cache.
        for (b = 0; b < 16; b = b + 1) z80.io_write( (b << 8) | 8'h30, 8'hFF );
        
        for (i = 0; i < 32; i = i + 1) begin
            
            // 1. Re-program the MMU for the current 16 pages
            for (b = 0; b < 16; b = b + 1) begin
                card_target = (b % 2 == 0) ? 8'h00 : 8'h01; 
                phys_page   = (i * 8) + (b / 2);
                z80.io_write( (b << 8) | (8'h30 | card_target), phys_page );
            end
            
            // 2. Read and Verify the 16-bit sequence number
            for (b = 0; b < 16; b = b + 1) begin
                seq_num = (i * 16) + b + 1;
                bank_addr = b * 16'h1000;
                
                z80.mem_read(bank_addr,     read_lo);
                z80.mem_read(bank_addr + 1, read_hi);
                
                if ({read_hi, read_lo} !== seq_num[15:0]) begin
                    $display("!!! DATA CORRUPTION at Seq %0d (Bank %0d, Phys Page %0d on Card %0d) !!!", 
                             seq_num, b, phys_page, card_target);
                    $display("    Expected: %04x, Got: %02x%02x", seq_num, read_hi, read_lo);
                    errors = errors + 1;
                end
            end
            
            if (i % 8 == 7) $display("[%0t]   Verified %0d / 512 pages...", $time, (i+1)*16);
        end

        // ==========================================
        // Test Conclusion
        // ==========================================
        $display("=====================================================");
        if (errors == 0) begin
            $display(" SUCCESS: 1MB Distributed Memory Test Passed Perfectly (NoDMA)!");
            $display(" Both cards seamlessly shared the bus without contention.");
        end else begin
            $display(" FAILURE: Detected %0d memory corruption errors.", errors);
        end
        $display("=====================================================");
        $finish;
    end

    // --- System Watchdog Timer ---
    // This is a long test! Needs a hefty watchdog (~1.5ms simulated time)
    initial begin
        #5000000;
        $display("FATAL [%0t]: Watchdog Timer Expired! Testbench deadlock detected.", $time);
        $fatal(1);
    end

endmodule
