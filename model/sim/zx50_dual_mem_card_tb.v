`timescale 1ns/1ps

/***************************************************************************************
 * ZX50 DUAL MEMORY CARD SYSTEM TESTBENCH
 * =====================================================================================
 * Description:
 * This testbench physically simulates a distributed memory architecture across 
 * a shared Z80 backplane with Card 0 (Boot ROM) and Card 1 (RAM Expansion).
 *
 * Test Sequence:
 * 1. ROM/RAM Coexistence: Proves Card 0 ROM and Card 1 RAM can share the bus safely.
 * 2. MMU Page Stealing: Proves that when one card maps a logical page, any other 
 * card owning that page dynamically drops it via I/O snooping to prevent contention.
 * 3. High-Speed Handoff: Interleaves 16 pages to prove zero-contention bus flips.
 ***************************************************************************************/

module zx50_dual_mem_card_tb;

    // --- 1. System Clocks (Generated by Timebase) ---
    wire mclk, zclk;
    zx50_clock clk_gen (
        .mclk(mclk),
        .zclk(zclk)
    );

    // --- 2. System Signals ---
    reg reset_n;

    // --- 3. Z80 Backplane Buses ---
    wire [15:0] z80_addr;
    wire [7:0]  z80_data;
    wire z80_mreq_n, z80_iorq_n, z80_wr_n, z80_rd_n, z80_m1_n;
    
    // Wait logic: Wired-AND (if either card pulls low, the bus goes low)
    wire c0_wait_n, c1_wait_n;
    wire shared_wait_n = c0_wait_n & c1_wait_n; 
    
    // Interrupt Daisy Chain
    wire c0_ieo, c1_ieo;
    wire z80_int_n;

    // --- 4. Shadow Bus (Inactive for this test) ---
    wire [15:0] sh_addr;
    wire [7:0]  sh_data;
    wire sh_en_n, sh_rw_n, sh_inc_n, sh_stb_n, sh_done_n, sh_busy_n;

    assign sh_en_n = 1'b1;
    assign sh_rw_n = 1'b1;

    // --- 5. BFM Instantiations ---
    z80_cpu_util z80 (
        .clk(zclk), .addr(z80_addr), .data(z80_data),
        .mreq_n(z80_mreq_n), .iorq_n(z80_iorq_n), 
        .rd_n(z80_rd_n), .wr_n(z80_wr_n), .m1_n(z80_m1_n),
        .wait_n(shared_wait_n)
    );

    // Card 0 (ID: 0x0) - Boot ROM enabled
    zx50_mem_card card0 (
        .mclk(mclk), .reset_n(reset_n), .card_id_sw(4'h0),
        .z80_addr(z80_addr), .z80_data(z80_data),
        .z80_mreq_n(z80_mreq_n), .z80_iorq_n(z80_iorq_n), .z80_wr_n(z80_wr_n), .z80_rd_n(z80_rd_n),
        .z80_m1_n(z80_m1_n), .z80_iei(1'b1), // Top of the chain
        .z80_wait_n(c0_wait_n), .z80_ieo(c0_ieo), .z80_int_n(z80_int_n),
        .sh_addr(sh_addr), .sh_data(sh_data),
        .sh_en_n(sh_en_n), .sh_rw_n(sh_rw_n), .sh_inc_n(sh_inc_n), 
        .sh_stb_n(sh_stb_n), .sh_done_n(sh_done_n), .sh_busy_n(sh_busy_n)
    );

    // Card 1 (ID: 0x1) - RAM only
    zx50_mem_card card1 (
        .mclk(mclk), .reset_n(reset_n), .card_id_sw(4'h1),
        .z80_addr(z80_addr), .z80_data(z80_data),
        .z80_mreq_n(z80_mreq_n), .z80_iorq_n(z80_iorq_n), .z80_wr_n(z80_wr_n), .z80_rd_n(z80_rd_n),
        .z80_m1_n(z80_m1_n), .z80_iei(c0_ieo), // Chained from Card 0
        .z80_wait_n(c1_wait_n), .z80_ieo(c1_ieo), .z80_int_n(z80_int_n),
        .sh_addr(sh_addr), .sh_data(sh_data),
        .sh_en_n(sh_en_n), .sh_rw_n(sh_rw_n), .sh_inc_n(sh_inc_n), 
        .sh_stb_n(sh_stb_n), .sh_done_n(sh_done_n), .sh_busy_n(sh_busy_n)
    );

    // --- 6. Test Sequence Variables ---
    integer b;
    reg [7:0] read_val;

    initial begin
        $dumpfile("waves/zx50_dual_mem_card.vcd");
        $dumpvars(0, zx50_dual_mem_card_tb);

        // --- Boot Sequence ---
        $display("[%0t] System Power On. Resetting dual cards...", $time);
        reset_n = 1;      
        clk_gen.wait_mclk(5); 
        reset_n = 0;  
        clk_gen.wait_mclk(50); 
        reset_n = 1;
        clk_gen.wait_mclk(20);
        z80.wait_cycles(5);

        // ==========================================
        // PHASE 1: ROM/RAM Coexistence
        // ==========================================
        $display("\n[%0t] --- PHASE 1: ROM/RAM Coexistence ---", $time);
        
        // Card 0 Boot ROM is active at 0x0000. Read it.
        z80.mem_read(16'h0000, read_val);
        if (read_val !== 8'hFF) begin $display("FATAL: Card 0 ROM failed. Got %h", read_val); $fatal(1); end
        
        // Map Page 8 (0x8000) to Card 1, Phys Page 0x10
        z80.io_write(16'h0831, 8'h10); 
        z80.wait_cycles(2);
        
        // Write/Read Card 1 RAM
        z80.mem_write(16'h8123, 8'hAA);
        z80.mem_read(16'h8123, read_val);
        if (read_val !== 8'hAA) begin $display("FATAL: Card 1 RAM failed. Got %h", read_val); $fatal(1); end
        
        $display("  > Success: Card 0 ROM and Card 1 RAM co-exist perfectly.");

        // ==========================================
        // PHASE 2: MMU Page Stealing (Snooping)
        // ==========================================
        $display("\n[%0t] --- PHASE 2: MMU Page Stealing ---", $time);
        
        // Map Page 8 (0x8000) to Card 0, Phys Page 0x20
        // Card 1 MUST snoop this and drop its ownership of Page 8!
        z80.io_write(16'h0830, 8'h20); 
        z80.wait_cycles(2);
        
        // Write to Card 0 RAM
        z80.mem_write(16'h8123, 8'hBB);
        z80.mem_read(16'h8123, read_val);
        if (read_val !== 8'hBB) begin $display("FATAL: Card 0 RAM write failed. Got %h", read_val); $fatal(1); end
        
        // Map Page 8 BACK to Card 1. 
        z80.io_write(16'h0831, 8'h10); 
        z80.wait_cycles(2);
        
        // Read Card 1. It should still hold '0xAA' from Phase 1. 
        // If Card 0 didn't drop ownership, we will get a bus collision (x) or 0xBB.
        z80.mem_read(16'h8123, read_val);
        if (read_val !== 8'hAA) begin $display("FATAL: MMU Steal failed! Expected AA, Got %h", read_val); $fatal(1); end
        
        $display("  > Success: Dynamic Page Ownership (Snooping) works seamlessly.");

        // ==========================================
        // PHASE 3: High-Speed Interleaving & Kill Switch
        // ==========================================
        $display("\n[%0t] --- PHASE 3: High-Speed Bus Handoff ---", $time);
        
        // Hit the Kill Switch on Card 0 by programming Page 0
        z80.io_write(16'h0030, 8'h00);
        
        // Map 16 logical pages. Even -> Card 0, Odd -> Card 1.
        for (b = 0; b < 16; b = b + 1) begin
            if (b % 2 == 0) z80.io_write( (b << 8) | 16'h0030, b ); // Card 0
            else            z80.io_write( (b << 8) | 16'h0031, b ); // Card 1
        end
        
        // Write sequence
        for (b = 0; b < 16; b = b + 1) z80.mem_write(b * 16'h1000, b);
        
        // Read/Verify sequence
        for (b = 0; b < 16; b = b + 1) begin
            z80.mem_read(b * 16'h1000, read_val);
            if (read_val !== b) begin
                $display("FATAL: Interleave failed at Page %0d. Expected %0x, Got %0x", b, b[7:0], read_val);
                $fatal(1);
            end
        end
        
        $display("  > Success: 16-Page High-Speed Interleave passed with zero contention.");

        // ==========================================
        // Test Conclusion
        // ==========================================
        $display("\n=====================================================");
        $display(" SUCCESS: DUAL CARD INTEGRATION PASSED!");
        $display("=====================================================");
        $finish;
    end

    // --- System Watchdog Timer ---
    initial begin
        #500000;
        $display("FATAL [%0t]: Watchdog Timer Expired! Testbench deadlock detected.", $time);
        $fatal(1);
    end

endmodule