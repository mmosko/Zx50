`timescale 1ns/1ps

/***************************************************************************************
 * MODULE: zx50_cpld_core_tb
 * =====================================================================================
 * WHAT IS BEING TESTED:
 * This testbench physically isolates the CPLD routing matrix. It proves that the 
 * CPLD dynamically multiplexes the various physical pins (Transceiver OEs, RAM CEs, 
 * ROM CEs) accurately under the control of the internal MMU and Arbiter sub-modules.
 *
 * TEST SEQUENCE:
 * - Phase 1 (Setup): The BFM configures the MMU to map Logical Page 0 to Physical 
 * Page 0x45 on Card 1. (0x45 has bit 7 set to '0', meaning it should hit RAM_CE0).
 * - Phase 2 (Write Validate): The Z80 writes to the mapped page. The TB asserts 
 * that `ram_ce0_n` drops low, `ram_we_n` drops low, and the transceivers correctly 
 * point inward.
 * - Phase 3 (Read Validate): The Z80 reads from the page. The TB asserts that 
 * `ram_ce0_n` and `ram_oe_n` drop low, and the transceivers correctly point outward.
 * - Phase 4 (ROM Bypass & Protect): Swaps to Card 0 (Boot Card). Verifies reads 
 * correctly bypass the MMU and assert `rom_ce_n`. Verifies writes to the ROM space 
 * are safely suppressed (no WE strobe).
 ***************************************************************************************/

module zx50_cpld_core_tb;

    // --- 1. System Clocks (Generated by the Timebase) ---
    wire mclk, zclk;
    zx50_clock clk_gen (
        .run_in(1'b1),
        .step_n_in(1'b1),
        .mclk(mclk),
        .zclk(zclk)
    );

    // --- 2. System Signals ---
    reg reset_n;
    reg z80_iei;
    reg [3:0] card_id_sw;

    // --- 3. Z80 Backplane Buses (Driven by BFM) ---
    wire [15:0] z80_addr;
    wire [7:0]  z80_data;
    wire z80_mreq_n, z80_iorq_n, z80_rd_n, z80_wr_n, z80_m1_n;
    wire z80_wait_n, z80_ieo, z80_int_n;

    // --- 4. Shadow DMA Bus (Inactive for this test) ---
    wire sh_en_n, sh_rw_n, sh_inc_n, sh_stb_n, sh_done_n, sh_busy_n;
    wire sh_c_dir;
    
    // Default Shadow Bus Pull-ups
    assign sh_en_n = 1'b1; 
    assign sh_rw_n = 1'b1;

    // --- 5. CPLD Output Pins to Monitor ---
    wire [11:0] l_addr; // Rev 1.0 Clean Hardware 12-bit offset
    wire [3:0]  atl_addr;
    wire [7:0]  atl_data;
    wire atl_we_n, atl_oe_n, atl_ce_n;
    wire ram_ce0_n, ram_ce1_n, rom_ce_n, ram_oe_n, ram_we_n;
    wire z80_data_oe_n, l_dir;

    // --- 6. The Duplex Handoff Logic ---
    wire [3:0] duplex_bus = (reset_n) ? {z80_iorq_n, z80_mreq_n, z80_wr_n, z80_rd_n} : card_id_sw;

    // --- 7. BFM Instantiations ---

    // Z80 Master
    z80_cpu_util z80 (
        .clk(zclk), .addr(z80_addr), .data(z80_data),
        .mreq_n(z80_mreq_n), .iorq_n(z80_iorq_n), 
        .rd_n(z80_rd_n), .wr_n(z80_wr_n), .m1_n(z80_m1_n),
        .wait_n(z80_wait_n) 
    );

    // The Device Under Test
    zx50_cpld_core dut (
        .mclk(mclk), .reset_n(reset_n), 
        .duplex_in(duplex_bus), 
        .z80_m1_n(z80_m1_n), .z80_iei(z80_iei), .z80_ieo(z80_ieo),
        .z80_int_n(z80_int_n), .z80_wait_n(z80_wait_n),
        
        .z80_addr(z80_addr), .l_data(z80_data), 
        
        .sh_en_n(sh_en_n), .sh_rw_n(sh_rw_n), .sh_inc_n(sh_inc_n), 
        .sh_stb_n(sh_stb_n), .sh_done_n(sh_done_n), .sh_busy_n(sh_busy_n),
        .sh_c_dir(sh_c_dir),
        
        .l_addr(l_addr), .atl_addr(atl_addr), .atl_data(atl_data),
        .atl_we_n(atl_we_n), .atl_oe_n(atl_oe_n), .atl_ce_n(atl_ce_n),
        
        .ram_ce0_n(ram_ce0_n), .ram_ce1_n(ram_ce1_n), .rom_ce_n(rom_ce_n), 
        .ram_oe_n(ram_oe_n), .ram_we_n(ram_we_n),
        
        .z80_data_oe_n(z80_data_oe_n), .l_dir(l_dir)
    );

    // Bridge the mock structural LUT SRAM to the pins
    assign atl_data = (!atl_we_n) ? z80_data : 8'hzz;
    
    is61c256al lut_sram (
        .addr({11'b0, atl_addr}), .data(atl_data),
        .ce_n(atl_ce_n), .oe_n(atl_oe_n), .we_n(atl_we_n)
    );

    // --- 8. Test Sequence ---
    reg [7:0] dummy_data;

    initial begin
        $dumpfile("waves/zx50_cpld_core.vcd");
        $dumpvars(0, zx50_cpld_core_tb);

        // Setup
        z80_iei = 1;
        card_id_sw = 4'h1; // Let's use Card ID 0x1 (Standard RAM Card)
        
        // Boot Sequence
        reset_n = 1; #50 reset_n = 0; #700 reset_n = 1;
        clk_gen.wait_mclk(20);

        // ==========================================
        // PHASE 1: Program MMU
        // ==========================================
        $display("[%0t] Phase 1: Programming MMU Page 0 to 0x45 (Card 1)...", $time);
        z80.mmu_map_page(card_id_sw, 4'h0, 8'h45);
        z80.wait_cycles(5); 

        // ==========================================
        // PHASE 2: CPLD Output Validation (Write Cycle)
        // ==========================================
        $display("[%0t] Phase 2: Memory Write Validation...", $time);
        fork
            z80.mem_write(16'h0123, 8'hAA);
            begin
                wait(z80_wr_n == 1'b0);
                #10; // Wait for combinational logic to settle
                if (z80_data_oe_n !== 1'b0 || l_dir !== 1'b1) begin
                    $display("FATAL: Transceiver write logic failed! oe_n=%b, l_dir=%b", z80_data_oe_n, l_dir);
                    $fatal(1);
                end
                // Rev 1.0 Clean Hardware: Physical Page 0x45 has bit 7 as '0', meaning it targets ram_ce0_n
                if (ram_ce0_n !== 1'b0 || ram_ce1_n !== 1'b1 || rom_ce_n !== 1'b1 || ram_we_n !== 1'b0) begin
                    $display("FATAL: SRAM gating failed! ce0=%b, ce1=%b, rom=%b, we=%b", ram_ce0_n, ram_ce1_n, rom_ce_n, ram_we_n);
                    $fatal(1);
                end
                $display("--- Phase 2 Passed: CPLD routed write signals perfectly.");
            end
        join
        z80.wait_cycles(5);

        // ==========================================
        // PHASE 3: CPLD Output Validation (Read Cycle)
        // ==========================================
        $display("[%0t] Phase 3: Memory Read Validation...", $time);
        fork
            z80.mem_read(16'h0123, dummy_data);
            begin
                wait(z80_rd_n == 1'b0); 
                #10;
                if (ram_ce0_n !== 1'b0 || ram_ce1_n !== 1'b1 || rom_ce_n !== 1'b1 || ram_oe_n !== 1'b0) begin
                    $display("FATAL: SRAM read gating failed! ce0=%b, oe=%b", ram_ce0_n, ram_oe_n);
                    $fatal(1);
                end
                $display("--- Phase 3 Passed: CPLD routed read signals perfectly.");
            end
        join
        z80.wait_cycles(5);

        // ==========================================
        // PHASE 4: Boot ROM Bypass & Write Protect Verification
        // ==========================================
        $display("[%0t] Phase 4: Validating Boot ROM logic on Card 0...", $time);
        card_id_sw = 4'h0; // Switch to Card 0 (Boot ROM enabled)
        reset_n = 0; #500; reset_n = 1; // Reboot to latch Card 0
        clk_gen.wait_mclk(20);

        // 4A: Read should hit ROM CE
        fork
            z80.mem_read(16'h0123, dummy_data);
            begin
                wait(z80_rd_n == 1'b0); 
                #10;
                if (rom_ce_n !== 1'b0 || ram_ce0_n !== 1'b1 || ram_ce1_n !== 1'b1) begin
                    $display("FATAL: ROM Read Bypass failed! rom_ce_n=%b", rom_ce_n);
                    $fatal(1);
                end
            end
        join
        z80.wait_cycles(5);

        // 4B: Write should be suppressed to protect EEPROM
        fork
            z80.mem_write(16'h0123, 8'hBB);
            begin
                wait(z80_wr_n == 1'b0); 
                #10;
                if (rom_ce_n !== 1'b1 || ram_we_n !== 1'b1) begin
                    $display("FATAL: ROM Write Protect failed! rom_ce_n=%b, we_n=%b", rom_ce_n, ram_we_n);
                    $fatal(1);
                end
            end
        join
        z80.wait_cycles(5);
        $display("--- Phase 4 Passed: ROM bypass and write-protection are solid.");

        $display("=====================================================");
        $display(" SUCCESS: CPLD Core Logic is fully operational.");
        $display("=====================================================");
        $finish;
    end

    // --- System Watchdog Timer ---
    initial begin
        #250000;
        $display("FATAL [%0t]: Watchdog Timer Expired!", $time);
        $fatal(1);
    end
endmodule