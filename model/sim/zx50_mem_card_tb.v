`timescale 1ns/1ps

/***************************************************************************************
 * MODULE: zx50_mem_card_tb
 * DESCRIPTION:
 * The top-level integration test.
 * This proves that the CPLD core correctly manages the external SRAM and Flash models 
 * and physically routes the bidirectional data across the 74ABT245 transceivers.
 ***************************************************************************************/

module zx50_mem_card_tb;

    // --- 1. System Clocks (Generated by Timebase) ---
    wire mclk, zclk;
    zx50_clock clk_gen (
        .mclk(mclk),
        .zclk(zclk)
    );

    // --- 2. System Signals ---
    reg reset_n;
    reg [3:0] card_id;
    reg z80_iei;

    // --- 3. Z80 Backplane Buses (Driven by BFM) ---
    wire [15:0] z80_addr;
    wire [7:0]  z80_data;
    wire z80_mreq_n, z80_iorq_n, z80_wr_n, z80_rd_n, z80_m1_n;
    wire z80_wait_n, z80_ieo, z80_int_n;

    // --- 4. Shadow Bus (Mock - Inactive) ---
    wire [15:0] sh_addr;
    wire [7:0]  sh_data;
    wire sh_en_n, sh_rw_n, sh_inc_n, sh_stb_n, sh_done_n, sh_busy_n;

    // Default Shadow Bus Pull-ups (keeps transceivers quiet)
    assign sh_en_n = 1'b1;
    assign sh_rw_n = 1'b1;

    // --- 5. BFM Instantiations ---
    z80_cpu_util z80 (
        .clk(zclk),
        .addr(z80_addr),
        .data(z80_data),
        .mreq_n(z80_mreq_n),
        .iorq_n(z80_iorq_n),
        .rd_n(z80_rd_n),
        .wr_n(z80_wr_n),
        .m1_n(z80_m1_n),
        .wait_n(z80_wait_n)
    );

    zx50_mem_card dut (
        .mclk(mclk), .reset_n(reset_n), .card_id_sw(card_id),
        .z80_addr(z80_addr), .z80_data(z80_data),
        .z80_mreq_n(z80_mreq_n), .z80_iorq_n(z80_iorq_n), .z80_wr_n(z80_wr_n), .z80_rd_n(z80_rd_n),
        .z80_m1_n(z80_m1_n), .z80_iei(z80_iei),
        .z80_wait_n(z80_wait_n), .z80_ieo(z80_ieo), .z80_int_n(z80_int_n),
        .sh_addr(sh_addr), .sh_data(sh_data),
        .sh_en_n(sh_en_n), .sh_rw_n(sh_rw_n), .sh_inc_n(sh_inc_n), 
        .sh_stb_n(sh_stb_n), .sh_done_n(sh_done_n), .sh_busy_n(sh_busy_n)
    );

    // --- 6. Test Sequence ---
    reg [7:0] read_val;

    initial begin
        $dumpfile("waves/zx50_mem_card.vcd");
        $dumpvars(0, zx50_mem_card_tb);

        z80_iei = 1;

        // ======================================================================
        // TEST SUITE 1: CARD 1 (Standard RAM Expansion)
        // ======================================================================
        $display("\n--- STARTING TEST SUITE 1: CARD 1 (RAM ONLY) ---");
        card_id = 4'h1; 
        reset_n = 1; #50; reset_n = 0; #500; reset_n = 1;
        clk_gen.wait_mclk(20);

        $display("[%0t] Card 1: Programming MMU Page 0 to Physical 0x45...", $time);
        z80.io_write(16'h0031, 8'h45); 
        z80.wait_cycles(5);

        $display("[%0t] Card 1: Writing 0xA5 to SRAM 0x0123...", $time);
        z80.mem_write(16'h0123, 8'hA5);
        z80.wait_cycles(5);

        $display("[%0t] Card 1: Reading back from SRAM 0x0123...", $time);
        z80.mem_read(16'h0123, read_val);
        if (read_val !== 8'hA5) begin
            $display("!!! FAILURE: Card 1 Expected A5, got %h !!!", read_val);
            $fatal(1);
        end
        $display("Card 1 OK.");

        // ======================================================================
        // TEST SUITE 2: CARD 0 (Boot ROM Enabled)
        // ======================================================================
        $display("\n--- STARTING TEST SUITE 2: CARD 0 (BOOT ROM ENABLED) ---");
        card_id = 4'h0; 
        reset_n = 0; #500; reset_n = 1; 
        clk_gen.wait_mclk(20);

        // Preload the ROM model with test data across the 2K and 4K boundaries
        dut.rom.memory_array[19'h07FF] = 8'h12; // Just before 2K boundary
        dut.rom.memory_array[19'h0800] = 8'h34; // Just after 2K boundary
        dut.rom.memory_array[19'h0FFF] = 8'h56; // Just before 4K boundary
        dut.rom.memory_array[19'h1000] = 8'h78; // Just after 4K boundary

        // 2A: Verify ROM reads span boundaries linearly
        $display("[%0t] Card 0: Verifying linear ROM reads across 2K and 4K boundaries...", $time);
        
        z80.mem_read(16'h07FF, read_val);
        if (read_val !== 8'h12) begin $display("!!! FAILURE: ROM 0x07FF. Expected 12, got %h !!!", read_val); $fatal(1); end
        
        z80.mem_read(16'h0800, read_val);
        if (read_val !== 8'h34) begin $display("!!! FAILURE: ROM 0x0800. Expected 34, got %h !!!", read_val); $fatal(1); end
        
        z80.mem_read(16'h0FFF, read_val);
        if (read_val !== 8'h56) begin $display("!!! FAILURE: ROM 0x0FFF. Expected 56, got %h !!!", read_val); $fatal(1); end
        
        z80.mem_read(16'h1000, read_val);
        if (read_val !== 8'h78) begin $display("!!! FAILURE: ROM 0x1000. Expected 78, got %h !!!", read_val); $fatal(1); end

        // 2B: Verify ROM Write Protection
        $display("[%0t] Card 0: Attempting protected write to ROM at 0x07FF...", $time);
        z80.mem_write(16'h07FF, 8'h99);
        z80.wait_cycles(5);
        z80.mem_read(16'h07FF, read_val);
        if (read_val !== 8'h12) begin
            $display("!!! FAILURE: Card 0 ROM Write Protect failed. Expected 12, got %h !!!", read_val);
            $fatal(1);
        end

        // 2C: Verify Upper RAM still works while ROM is active in lower 32K
        $display("[%0t] Card 0: Programming MMU Page 8 (0x8000) to Physical 0x55...", $time);
        z80.io_write(16'h0830, 8'h55); 
        z80.wait_cycles(5);
        
        $display("[%0t] Card 0: Writing 0x22 to Upper RAM 0x8123...", $time);
        z80.mem_write(16'h8123, 8'h22);
        z80.wait_cycles(5);
        
        z80.mem_read(16'h8123, read_val);
        if (read_val !== 8'h22) begin
            $display("!!! FAILURE: Card 0 Upper RAM failed. Expected 22, got %h !!!", read_val);
            $fatal(1);
        end

        // 2D: Hit the Kill Switch to swap ROM for RAM
        $display("[%0t] Card 0: Hitting ROM Kill Switch (Programming Page 0)...", $time);
        z80.io_write(16'h0030, 8'h45); 
        z80.wait_cycles(5);

        // 2E: Verify ROM is gone and RAM is active
        $display("[%0t] Card 0: Writing 0x33 to newly exposed RAM 0x0123...", $time);
        z80.mem_write(16'h0123, 8'h33);
        z80.wait_cycles(5);
        
        z80.mem_read(16'h0123, read_val);
        if (read_val !== 8'h33) begin
            $display("!!! FAILURE: Card 0 Kill Switch failed. Expected 33, got %h !!!", read_val);
            $fatal(1);
        end

        $display("Card 0 OK.");

        $display("\n=====================================================");
        $display(" SUCCESS: Full Structural Integration Test Passed!");
        $display(" ROM Bypass, Write Protection, and MMU working perfectly.");
        $display("=====================================================\n");
        $finish;
    end

    // --- System Watchdog Timer ---
    initial begin
        #350000;
        $display("FATAL [%0t]: Watchdog Timer Expired! Testbench deadlock detected.", $time);
        $fatal(1);
    end

endmodule