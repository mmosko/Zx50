`timescale 1ns/1ps

/***************************************************************************************
 * MODULE: zx50_bus_arbiter_tb
 * =====================================================================================
 * WHAT IS BEING TESTED:
 * This is an isolated, exhaustive formal-style verification testbench for the 
 * zx50_bus_arbiter. It sweeps through all 16 possible combinations of input requests 
 * and read/write intents.
 * * CONTINUOUS INVARIANT CHECKING:
 * Instead of checking outputs at specific timestamps, this testbench relies on 
 * "Invariant Assertions" that run on every single clock edge. These invariants 
 * define the unbreakable physical safety rules of the PCB. If the Arbiter violates 
 * any of these rules for even one nanosecond, the simulation will instantly abort.
 ***************************************************************************************/

module zx50_bus_arbiter_tb;

    // --- 1. System Clocks (Generated by Timebase) ---
    wire mclk;
    zx50_clock clk_gen (
        .run_in(1'b1),
        .step_n_in(1'b1),
        .mclk(mclk),
        .zclk() // Z80 clock not needed for isolated combinatorial/state testing
    );

    // --- 2. System Signals & State ---
    reg reset_n;
    
    // 4-bit vector generating all 16 input combinations
    reg [3:0] test_vector;
    
    // Allows the state machine 8 clock cycles to step through DEAD states and settle
    reg [2:0] settle_counter;

    wire sh_en_n      = test_vector[0];
    wire z80_card_hit = test_vector[1];
    wire z80_rd_n     = test_vector[2];
    wire sh_rw_n      = test_vector[3];

    wire z80_wait_n, sh_busy_n;
    wire z80_data_oe_n, sh_data_oe_n, l_dir;

    // --- 3. DUT Instantiation ---
    zx50_bus_arbiter dut (
        .mclk(mclk), .reset_n(reset_n),
        .sh_en_n(sh_en_n), .z80_card_hit(z80_card_hit),
        .z80_wait_n(z80_wait_n), .sh_busy_n(sh_busy_n),
        .z80_rd_n(z80_rd_n), .sh_rw_n(sh_rw_n),
        .z80_data_oe_n(z80_data_oe_n), .sh_data_oe_n(sh_data_oe_n), .l_dir(l_dir) 
    );

    // --- 4. Setup & Reset ---
    initial begin
        $dumpfile("waves/zx50_bus_arbiter.vcd");
        $dumpvars(0, zx50_bus_arbiter_tb);
        
        reset_n = 0;
        test_vector = 4'b0000;
        settle_counter = 3'b000;
        
        clk_gen.wait_mclk(5); // Hold reset for 5 clock cycles
        reset_n = 1;
    end

    // --- 5. Exhaustive State Generation ---
    // GOAL: Sweep through all 16 possible combinations of bus requests and read/write states.
    always @(posedge mclk) begin
        if (reset_n) begin
            settle_counter <= settle_counter + 1'b1;
            
            // Allow 8 clock cycles for the Arbiter to transition through any DEAD states
            // and settle into its final stable ownership state before changing inputs.
            if (settle_counter == 3'b111) begin 
                if (test_vector == 4'b1111) begin
                    $display("=====================================================");
                    $display(" SUCCESS: All 16 Input States Tested.");
                    $display(" ZERO Bus Contention Violations Found.");
                    $display("=====================================================");
                    $finish;
                end else begin
                    test_vector <= test_vector + 1'b1;
                end
            end
        end
    end

    // --- 6. INVARIANT ASSERTIONS (Checked on every single clock cycle) ---
    // GOAL: These are the unbreakable physical safety rules of the PCB.
    // If any of these fail for even one nanosecond, the board could physically fry.
    always @(posedge mclk) begin
        if (reset_n) begin
            
            // INVARIANT 1: Mutual Exclusion on Shared Data Bus
            // Both the Z80 '245 and the Shadow '245 cannot be driving the L_DATA bus inward simultaneously.
            // If they both drive, and try to drive opposite bits, the ICs will short circuit.
            if (z80_data_oe_n == 0 && sh_data_oe_n == 0) begin
                $display("FATAL [%0t]: Shared Data Bus Short Circuit Detected! Both OEs active.", $time);
                $fatal(1); 
            end

            // INVARIANT 2: Z80 Safety Interlock
            // If the Z80 targets this card, but the arbiter has not yet opened the Z80 transceiver
            // (e.g., because it's in a DEAD state or yielding), the Z80 MUST be stalled using 
            // the WAIT line so it doesn't complete the cycle and drop the data/read garbage.
            if (z80_card_hit && (z80_data_oe_n != 0) && (z80_wait_n != 0)) begin
                $display("FATAL [%0t]: Z80 hit the card but transceivers are closed without a WAIT state!", $time);
                $fatal(1);
            end

            // INVARIANT 3: Shadow Bus Safety Interlock
            // If the Shadow DMA targets this card, but the arbiter has not yet opened the Shadow transceiver,
            // the Shadow bus MUST be stalled using the S_BUSY line.
            if (!sh_en_n && (sh_data_oe_n != 0) && (sh_busy_n != 0)) begin
                $display("FATAL [%0t]: Shadow bus hit the card but transceivers are closed without S_BUSY!", $time);
                $fatal(1);
            end
        end
    end

    // --- System Watchdog Timer ---
    initial begin
        #150000;
        $display("FATAL [%0t]: Watchdog Timer Expired! State machine stalled.", $time);
        $fatal(1);
    end

endmodule